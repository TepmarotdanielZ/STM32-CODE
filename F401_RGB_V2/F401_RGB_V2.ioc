# file: F401_RGB_V2.ioc
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Dma.Request0=TIM1_CH1
Dma.TIM1_CH1.0.Direction=DMA_MEMORY_TO_PERIPH
Dma.TIM1_CH1.0.FIFOMode=DMA_FIFOMODE_DISABLE
Dma.TIM1_CH1.0.Instance=DMA2_Stream1
Dma.TIM1_CH1.0.MemDataAlignment=DMA_MDATAALIGN_HALFWORD
Dma.TIM1_CH1.0.MemInc=DMA_MINC_ENABLE
Dma.TIM1_CH1.0.Mode=DMA_NORMAL
Dma.TIM1_CH1.0.PeriphDataAlignment=DMA_PDATAALIGN_HALFWORD
Dma.TIM1_CH1.0.PeriphInc=DMA_PINC_DISABLE
Dma.TIM1_CH1.0.Priority=DMA_PRIORITY_LOW
Mcu.Family=STM32F4
Mcu.Name=STM32F401C(B-C)Ux
Mcu.Package=UFQFPN48
NVIC.DMA2_Stream1_IRQn=true\:0\:0\:false\:false\:true\:false\:true\:true
NVIC.PriorityGroup=NVIC_PRIORITYGROUP_4
PA13.Mode=Serial_Wire
PA13.Signal=SYS_JTMS-SWDIO
PA14.Mode=Serial_Wire
PA14.Signal=SYS_JTCK-SWCLK
PA8.GPIO_Label=TIM1_CH1_RGB
PA8.Signal=S_TIM1_CH1
PH0\ -\ OSC_IN.Mode=HSE-External-Oscillator
PH0\ -\ OSC_IN.Signal=RCC_OSC_IN
PH1\ -\ OSC_OUT.Mode=HSE-External-Oscillator
PH1\ -\ OSC_OUT.Signal=RCC_OSC_OUT
ProjectManager.HeapSize=0x200
ProjectManager.StackSize=0x400
ProjectManager.TargetToolchain=STM32CubeIDE
RCC.48MHZClocksFreq_Value=42000000
RCC.AHBFreq_Value=84000000
RCC.APB1CLKDivider=RCC_HCLK_DIV2
RCC.APB1Freq_Value=42000000
RCC.APB1TimFreq_Value=84000000
RCC.APB2Freq_Value=84000000
RCC.APB2TimFreq_Value=84000000
RCC.CortexFreq_Value=84000000
RCC.HCLKFreq_Value=84000000
RCC.HSE_VALUE=25000000
RCC.HSI_VALUE=16000000
RCC.LSE_VALUE=32768
RCC.PLLM=25
RCC.PLLN=168
RCC.PLLSourceVirtual=RCC_PLLSOURCE_HSE
RCC.SYSCLKFreq_VALUE=84000000
RCC.SYSCLKSource=RCC_SYSCLKSOURCE_PLLCLK
RCC.VCOOutputFreq_Value=168000000
SH.S_TIM1_CH1.0=TIM1_CH1,PWM Generation1 CH1
TIM1.AutoReloadPreload=TIM_AUTORELOAD_PRELOAD_ENABLE
TIM1.Channel-PWM\ Generation1\ CH1=TIM_CHANNEL_1
TIM1.Period=104
VP_TIM1_VS_ClockSourceINT.Mode=Internal
board=custom

// file: Core/Src/main.c
/* USER CODE BEGIN Header */
/**
  ******************************************************************************
  * @file           : main.c
  * @brief          : Main program body
  ******************************************************************************
  * @attention
  *
  * Copyright (c) 2024 STMicroelectronics.
  * All rights reserved.
  *
  * This software is licensed under terms that can be found in the LICENSE file
  * in the root directory of this software component.
  * If no LICENSE file comes with this software, it is provided AS-IS.
  *
  ******************************************************************************
  */
/* USER CODE END Header */
#include "main.h"
#include "dma.h"
#include "tim.h"
#include "gpio.h"

/* USER CODE BEGIN PM */

uint32_t last_time = 0;
#define MAX_LED 8
#define USE_BRIGHTNESS 0

uint8_t LED_Data[MAX_LED][8];
uint8_t LED_Mod[MAX_LED][8];  /* FOR BRIGHTNESS */
uint16_t effStep = 0;
uint32_t K[3] = {0, 4, 8};
int GREEN[3] = {255, 0, 0};
int BLUE[3] = {0, 255, 0};
int RED[3] = {0, 0, 255};
int L = 4, M = 8,z;
int datasentflag=0;
int RGB_Blue = 0;
int RGB_Red = 255;
int RGB_Green =0;
int RGB_state = 0;
int RGB_Brightness = 255;

/* USER CODE END PM */

void SystemClock_Config(void);
/* USER CODE BEGIN PFP */

void HAL_TIM_PWM_PulseFinishedCallback(TIM_HandleTypeDef *htim)
{
	HAL_TIM_PWM_Stop_DMA(&htim1, TIM_CHANNEL_1);
	datasentflag=1;
}

void Set_LED (int LEDnum, int Red, int Green, int Blue)
{
	LED_Data[LEDnum][0] = LEDnum;
	LED_Data[LEDnum][1] = Green;
	LED_Data[LEDnum][2] = Red;
	LED_Data[LEDnum][3] = Blue;
}

#define PI 3.14159265

void Set_Brightness (int brightness)  // 0-45
{
#if USE_BRIGHTNESS

	if (brightness > 45) brightness = 45;
	for (int i=0; i<MAX_LED; i++)
	{
		LED_Mod[i][0] = LED_Data[i][0];
		for (int j=1; j<4; j++)
		{
			float angle = 90-brightness;  // in degrees
			angle = angle*PI / 180;  // in rad
			LED_Mod[i][j] = (LED_Data[i][j])/(tan(angle));
		}
	}

#endif

}

uint16_t pwmData[(24*MAX_LED)+50];

void WS2812_Send (void)
{
	uint32_t indx=0;
	uint32_t color;

	for (int i= 0; i<MAX_LED; i++)
	{
#if USE_BRIGHTNESS
		color = ((LED_Mod[i][1]<<16) | (LED_Mod[i][2]<<8) | (LED_Mod[i][3]));
#else
		color = ((LED_Data[i][1]<<16) | (LED_Data[i][2]<<8) | (LED_Data[i][3]));
#endif

		for (int i=23; i>=0; i--)
		{
			if (color&(1<<i))
			{
				pwmData[indx] = 70;  // 2/3 of 105/70
			}

			else pwmData[indx] = 35;  // 1/3 of 105/37

			indx++;
		}

	}

	for (int i=0; i<50; i++)
	{
		pwmData[indx] = 0;
		indx++;
	}

	HAL_TIM_PWM_Start_DMA(&htim1, TIM_CHANNEL_1, (uint32_t *)pwmData, indx);
	while (!datasentflag){};
	datasentflag = 0;
}

void Reset_LED (void)
{
	for (int i=0; i<MAX_LED; i++)
	{
		LED_Data[i][0] = i;
		LED_Data[i][1] = 0;
		LED_Data[i][2] = 0;
		LED_Data[i][3] = 0;
	}
}

double map(double x, double in_min, double in_max, double out_min,
		double out_max) {
	return (x - in_min) * (out_max - out_min) / (in_max - in_min) + out_min;
}

void RGB_Speed(){
	// if(HAL_GetTick() - last_time >= map(RxData[0],0,255,20,250)){
	  	last_time = HAL_GetTick();

	  	for(int i = 0;i<=2; i++){
			K[i]++;
			if(K[i] == 12){
				K[i]=0;
				Set_LED(K[i], RED[i], GREEN[i], BLUE[i]);
				Set_Brightness(0);
				Set_LED(11, 0, 0, 0);

				WS2812_Send();
			}
			if(K[i]>=1 && K[i]<=11){
				Set_LED(K[i],RED[i], GREEN[i], BLUE[i]);
				Set_LED(K[i]-1, 0, 0, 0);
				WS2812_Send();
			}
	  	}

	  }

/* USER CODE END PFP */

int main(void)
{

  /* MCU Configuration--------------------------------------------------------*/

  /* Reset of all peripherals, Initializes the Flash interface and the Systick. */
  HAL_Init();

  /* Configure the system clock */
  SystemClock_Config();

  /* Initialize all configured peripherals */
  MX_GPIO_Init();
  MX_DMA_Init();
  MX_TIM1_Init();
  /* USER CODE BEGIN 2 */

  	  Reset_LED();

  /* USER CODE END 2 */

  /* Infinite loop */
  while (1)
  {

    /* USER CODE BEGIN 3 */

	  /* RGB */

	  if(HAL_GetTick() - last_time >= 30 ){
	  	last_time = HAL_GetTick();

	  	if (RGB_state == 0){
		  	RGB_Red = RGB_Brightness;
		  	RGB_Green ++;
		  	RGB_Blue = 0;
		  	if(RGB_Green >= RGB_Brightness){
		  		RGB_state = 1;
		  	}
	  	}
	  	else if (RGB_state == 1){
		  	RGB_Red --;
		  	RGB_Green = RGB_Brightness;
		  	RGB_Blue = 0;
		  	if(RGB_Red <= 0){
		  		RGB_state = 2;
		  	}
	  	}
	  	else if (RGB_state == 2){
		  	RGB_Red = 0;
		  	RGB_Green = RGB_Brightness;
		  	RGB_Blue ++;
		  	if(RGB_Blue >= RGB_Brightness){
		  		RGB_state = 3;
		  	}
	  	}
	  	else if (RGB_state == 3){
		  	RGB_Red = 0;
		  	RGB_Green --;
		  	RGB_Blue = RGB_Brightness;
		  	if(RGB_Green <= 0){
		  		RGB_state = 4;
		  	}
	  	}
	  	else if (RGB_state == 4){
		  	RGB_Red ++;
		  	RGB_Green = 0;
		  	RGB_Blue = RGB_Brightness;
		  	if(RGB_Red >= RGB_Brightness){
		  		RGB_state = 5;
		  	}	  	}
	  	else if (RGB_state == 5){
		  	RGB_Red = RGB_Brightness;
		  	RGB_Green = 0;
		  	RGB_Blue --;
		  	if(RGB_Blue <= 0){
		  		RGB_state = 0;
		  	}	  	}

	  	else{

	  	}

	  }
		Set_LED(0, RGB_Red, RGB_Green, RGB_Blue);
		Set_LED(1, RGB_Red, RGB_Green, RGB_Blue);
		Set_LED(2, RGB_Red, RGB_Green, RGB_Blue);
		Set_LED(3, RGB_Red, RGB_Green, RGB_Blue);
		Set_LED(4, RGB_Red, RGB_Green, RGB_Blue);
		Set_LED(5, RGB_Red, RGB_Green, RGB_Blue);
		Set_LED(6, RGB_Red, RGB_Green, RGB_Blue);
		Set_LED(7, RGB_Red, RGB_Green, RGB_Blue);
		WS2812_Send();

  }
  /* USER CODE END 3 */
}

void SystemClock_Config(void)
{
  RCC_OscInitTypeDef RCC_OscInitStruct = {0};
  RCC_ClkInitTypeDef RCC_ClkInitStruct = {0};

  /** Configure the main internal regulator output voltage
  */
  __HAL_RCC_PWR_CLK_ENABLE();
  __HAL_PWR_VOLTAGESCALING_CONFIG(PWR_REGULATOR_VOLTAGE_SCALE2);

  /** Initializes the RCC Oscillators according to the specified parameters
  * in the RCC_OscInitTypeDef structure.
  */
  RCC_OscInitStruct.OscillatorType = RCC_OSCILLATORTYPE_HSE;
  RCC_OscInitStruct.HSEState = RCC_HSE_ON;
  RCC_OscInitStruct.PLL.PLLState = RCC_PLL_ON;
  RCC_OscInitStruct.PLL.PLLSource = RCC_PLLSOURCE_HSE;
  RCC_OscInitStruct.PLL.PLLM = 25;
  RCC_OscInitStruct.PLL.PLLN = 168;
  RCC_OscInitStruct.PLL.PLLP = RCC_PLLP_DIV2;
  RCC_OscInitStruct.PLL.PLLQ = 4;
  if (HAL_RCC_OscConfig(&RCC_OscInitStruct) != HAL_OK)
  {
    Error_Handler();
  }

  /** Initializes the CPU, AHB and APB buses clocks
  */
  RCC_ClkInitStruct.ClockType = RCC_CLOCKTYPE_HCLK|RCC_CLOCKTYPE_SYSCLK
                              |RCC_CLOCKTYPE_PCLK1|RCC_CLOCKTYPE_PCLK2;
  RCC_ClkInitStruct.SYSCLKSource = RCC_SYSCLKSOURCE_PLLCLK;
  RCC_ClkInitStruct.AHBCLKDivider = RCC_SYSCLK_DIV1;
  RCC_ClkInitStruct.APB1CLKDivider = RCC_HCLK_DIV2;
  RCC_ClkInitStruct.APB2CLKDivider = RCC_HCLK_DIV1;

  if (HAL_RCC_ClockConfig(&RCC_ClkInitStruct, FLASH_LATENCY_2) != HAL_OK)
  {
    Error_Handler();
  }
}

void Error_Handler(void)
{
  __disable_irq();
  while (1)
  {
  }
}
